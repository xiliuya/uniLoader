## configs/b2q_defconfig
```kconfig
CONFIG_POSITION_INDEPENDENT=y
CONFIG_SM8350=y
CONFIG_SAMSUNG_B2Q=y
CONFIG_SIMPLE_FB=y
CONFIG_TEXT_BASE=0xc0000000
CONFIG_PAYLOAD_ENTRY=0xa0280000
CONFIG_RAMDISK_ENTRY=0xa4000000
CONFIG_FDT_BUF_SIZE=1048576
CONFIG_LINUX_KRNL_HEADER_IMG=y
```
